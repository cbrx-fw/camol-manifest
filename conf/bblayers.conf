## conf/bblayers.conf
```bitbake
# LAYER_CONF_VERSION is increased each time build/conf/bblayers.conf
# changes incompatibly
LCONF_VERSION = "7"
TOPDIR := "${@os.path.dirname(os.path.dirname(d.getVar('FILE', True)))}"

BBPATH = "${TOPDIR}"

BBFILES = ""

# These layers hold recipe metadata not found in OE-core, but lack any machine or distro content
BASELAYERS ?= " \
  ${TOPDIR}/layers/meta-openembedded/meta-oe \
  ${TOPDIR}/layers/meta-openembedded/meta-efl \
  ${TOPDIR}/layers/meta-openembedded/meta-gpe \
  ${TOPDIR}/layers/meta-openembedded/meta-gnome \
  ${TOPDIR}/layers/meta-openembedded/meta-xfce \
  ${TOPDIR}/layers/meta-openembedded/meta-initramfs \
  ${TOPDIR}/layers/meta-openembedded/meta-multimedia \
  ${TOPDIR}/layers/meta-openembedded/meta-networking \
  ${TOPDIR}/layers/meta-openembedded/meta-webserver \
  ${TOPDIR}/layers/meta-openembedded/meta-ruby \
  ${TOPDIR}/layers/meta-openembedded/meta-filesystems \
  ${TOPDIR}/layers/meta-openembedded/meta-perl \
  ${TOPDIR}/layers/meta-openembedded/meta-python \
  ${TOPDIR}/layers/meta-java \
  ${TOPDIR}/layers/meta-browser \
  ${TOPDIR}/layers/meta-mono \
  ${TOPDIR}/layers/meta-qt5 \
  ${TOPDIR}/layers/meta-openembedded/meta-systemd \
  ${TOPDIR}/layers/meta-ros \
  ${TOPDIR}/layers/meta-telephony \
  ${TOPDIR}/layers/meta-photography \
  ${TOPDIR}/layers/meta-maker \
"

# These layers hold machine specific content, aka Board Support Packages
BSPLAYERS ?= " \
  ${TOPDIR}/layers/meta-cbrx \
  ${TOPDIR}/layers/meta-ti \
"

# Add your overlay location to EXTRALAYERS
# Make sure to have a conf/layers.conf in there
EXTRALAYERS ?= " \
  ${TOPDIR}/layers/meta-linaro/meta-linaro \
  ${TOPDIR}/layers/meta-linaro/meta-linaro-toolchain \
  ${TOPDIR}/layers/meta-linaro/meta-aarch64 \
"

BBLAYERS = " \
  ${TOPDIR}/layers/meta-camol \
  ${BASELAYERS} \
  ${BSPLAYERS} \
  ${EXTRALAYERS} \
  ${TOPDIR}/layers/openembedded-core/meta \
"
```
